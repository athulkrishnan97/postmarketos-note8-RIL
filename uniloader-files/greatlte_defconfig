## uniloader-files/greatlte_defconfig
```kconfig
CONFIG_POSITION_INDEPENDENT=y
# CONFIG_COMPRESS_GZIP is not set
CONFIG_EXYNOS_8895=y
CONFIG_EXYNOS_SPEEDY=y
CONFIG_SAMSUNG_GREATLTE=y
CONFIG_TEXT_BASE=0x87000000
CONFIG_PAYLOAD_ENTRY=0x80200000
CONFIG_RAMDISK_ENTRY=0x84000000
```
